/*
 * Copyright (c) 2015-2016, The Linux Foundation. All rights reserved.
 *
 * This program is free software; you can redistribute it and/or modify
 * it under the terms of the GNU General Public License version 2 and
 * only version 2 as published by the Free Software Foundation.
 *
 * This program is distributed in the hope that it will be useful,
 * but WITHOUT ANY WARRANTY; without even the implied warranty of
 * MERCHANTABILITY or FITNESS FOR A PARTICULAR PURPOSE.  See the
 * GNU General Public License for more details.
 */

/*---------------------------------------------------------------------------
 * This file is autogenerated file using gcdb parser. Please do not edit it.
 * Update input XML file to add a new entry or update variable in this file
 * VERSION = "1.0"
 *---------------------------------------------------------------------------*/
&mdss_mdp {
	dsi_hx8394f_720p_video: qcom,mdss_dsi_hx8394f_720p_video {
		qcom,mdss-dsi-panel-name = "hx8394f 720p video mode dsi panel"; //用作面板描述性名称的字符串
		qcom,mdss-dsi-panel-controller = <&mdss_dsi0>;        //指定dsi接口
		qcom,mdss-dsi-panel-type = "dsi_video_mode";          //指定面板操作模式。
                //"dsi_video_mode"=启用视频模式（默认）。
                //"dsi_cmd_mode"=启用命令模式。
		qcom,mdss-dsi-panel-destination = "display_1";        //指定面板的目标显示 "display_1" = DISPLAY_1;"display_2" = DISPLAY_2
		qcom,mdss-dsi-panel-framerate = <60>;                 //指定面板的帧速率。 60 =每秒60帧（默认）
		qcom,mdss-dsi-virtual-channel-id = <0>;               //指定虚拟通道标识符。 0 =默认值。
		qcom,mdss-dsi-stream = <0>;                           //指定要使用的数据包流。
					//0 = stream 0 (default)
					//1 = stream 1
		qcom,mdss-dsi-panel-width = <720>;                    //面板宽度，单位像素
		qcom,mdss-dsi-panel-height = <1280>;                  //面板高度，单位像素

		qcom,mdss-pan-physical-width-dimension = <68>;        //指定面板物理宽度，单位为mm，对应于帧缓冲区信息中的物理宽度。
		qcom,mdss-pan-physical-height-dimension = <121>;      //指定面板物理高度，单位为mm，对应于帧缓冲区信息中的物理高度。


		qcom,mdss-dsi-h-front-porch = <16>;                   //像素中的水平前沿值
		qcom,mdss-dsi-h-back-porch = <16>;                    //像素中的水平后沿值
		qcom,mdss-dsi-h-pulse-width = <10>;                   //水平脉冲宽度
		qcom,mdss-dsi-h-sync-skew = <0>;                      //水平同步偏斜值
		qcom,mdss-dsi-v-back-porch = <12>;                    //像素中的垂直后沿值
		qcom,mdss-dsi-v-front-porch = <15>                    //像素中的垂直前沿值
		qcom,mdss-dsi-v-pulse-width = <4>;                    //垂直脉冲宽度
		qcom,mdss-dsi-h-left-border = <0>;                    //像素中的水平左边框
		qcom,mdss-dsi-h-right-border = <0>;                   //像素中的水平右边框
		qcom,mdss-dsi-v-top-border = <0>;                     //像素中的垂直顶部边框
		qcom,mdss-dsi-v-bottom-border = <0>;                  //像素中的垂直底部部边框
		qcom,mdss-dsi-bpp = <24>;                             //指定每个像素面板位数 3=rgb111 ;8=rgb332 ;12=rgb444 ;16=rgb565 ;18=rgb666 ;24=rgb888
		qcom,mdss-dsi-underflow-color = <0xff>;               //指定流颜色下面板的控制器设置。 0xff =默认值
		qcom,mdss-dsi-border-color = <0>;                     //如果存在边框，则定义边框颜色值。 0 =默认值。
		qcom,mdss-dsi-on-command = [39 01 00 00 00 00 04 B9 FF 83 94
				39 01 00 00 00 00 07
					BA 63 03 68 6B B2 C0
				39 01 00 00 00 00 0B
					B1 48 12 72 09 32 54 71 71 57 47
				39 01 00 00 00 00 07
					B2 00 80 64 0C 0D 2F
				39 01 00 00 00 00 16
					B4 73 74 73 74 73 74 01 0C 86 75
					00 3F 73 74 73 74 73 74 01 0C 86
				39 01 00 00 00 00 03
				        B6 6E 6E
				39 01 00 00 00 00 22
					D3 00 00 07 07 40 07 0C 00 08 10
					08 00 08 54 15 0A 05 0A 02 15 06
					05 06 47 44 0A 0A 4B 10 07 07 0C
					40
				39 01 00 00 00 00 2D
					D5 1C 1C 1D 1D 00 01 02 03 04 05
					06 07 08 09 0A 0B 24 25 18 18 26
					27 18 18 18 18 18 18 18 18 18 18
					18 18 18 18 18 18 20 21 18 18 18
					18
				39 01 00 00 00 00 2D
					D6 1C 1C 1D 1D 07 06 05 04 03 02
					01 00 0B 0A 09 08 21 20 18 18 27
					26 18 18 18 18 18 18 18 18 18 18
					18 18 18 18 18 18 25 24 18 18 18
					18
				39 01 00 00 00 00 3B
				        E0 00 09 19 1E 20 25 2B 28 51 63
					73 70 76 85 89 8B 97 97 90 9B A8
					51 4F 50 52 54 55 56 7F 00 08 17
					1F 22 25 29 24 49 58 65 64 6C 7D
					83 87 92 92 8D 99 A7 52 4F 51 54
					55 59 5A 7F

				39 01 00 00 00 00 03 C0 1F 31
				15 01 00 00 00 00 02 CC 0B
				15 01 00 00 00 00 02 D4 02
				15 01 00 00 00 00 02 BD 02
				39 01 00 00 00 00 0D
					D8 FF FF FF FF FF FF FF FF FF FF
					FF FF
				15 01 00 00 00 00 02 BD 00
				15 01 00 00 00 00 02 BD 01
				15 01 00 00 00 00 02 B1 00
				15 01 00 00 00 00 02 BD 00
				39 01 00 00 00 00 08
					BF 40 81 50 00 1A FC 01
				15 01 00 00 00 00 02 C6 EF
				15 01 00 00 00 00 02 36 03
				05 01 00 00 96 00 02 11 00
				05 01 00 00 14 00 02 29 00];//基于qcom dsi控制器协议的多个dcs数据包形成的字节流。

		qcom,mdss-dsi-off-command = [05 01 00 00 78 00 02 28 00
				05 01 00 00 96 00 02 10 00]; //基于qcom dsi控制器协议的多个dcs数据包形成的字节流。
		qcom,mdss-dsi-on-command-state = "dsi_lp_mode"; //指定发送ON命令的ctrl状态的字符串。
              //"dsi_lp_mode"= DSI低功耗模式（默认）
              //"dsi_hs_mode"= DSI高速模式
		qcom,mdss-dsi-off-command-state = "dsi_lp_mode"; //指定发送ON命令的ctrl状态的字符串。
              //"dsi_lp_mode"= DSI低功耗模式（默认）
              //"dsi_hs_mode"= DSI高速模式
		qcom,mdss-dsi-h-sync-pulse = <1>;       //指定面板的脉冲模式选项。
              //0 =不要在vs/ve包后发送hsa/he（默认）
              //1 =在vs/ve数据包之后发送hsa/he
		qcom,mdss-dsi-traffic-mode = "burst_mode";  //指定面板流量模式。
              //"non_burst_sync_pulse"=具有同步脉冲的非突发（默认）。
              //"non_burst_sync_event"=具有同步开始事件的非突发。
              //"burst_mode"=突发模式。
		qcom,mdss-dsi-lane-map = "lane_map_0123";
		qcom,mdss-dsi-bllp-eof-power-mode;    //布尔值，用于确定消隐低功率周期（BLLP）EOF模式期间的DSI通道状态
		qcom,mdss-dsi-bllp-power-mode;        //布尔值，用于确定消隐低功率周期（BLLP）模式期间的DSI通道状态。
		qcom,mdss-dsi-lane-0-state;           //布尔值，指定是否启用数据通道0。
		qcom,mdss-dsi-lane-1-state;           //布尔值，指定是否启用数据通道1。
		qcom,mdss-dsi-lane-2-state;           //布尔值，指定是否启用数据通道2。
		qcom,mdss-dsi-lane-3-state;           //布尔值，指定是否启用数据通道3。
		qcom,mdss-dsi-panel-timings
			= [6A 16 0E 00 38 3c 12 1A 10 03 04 00];//长度为12的数组，指定面板的PHY时序设置。
		qcom,mdss-dsi-t-clk-post = <0x04>;        //指定模式切换后的字节时钟周期。 0x03 =默认值。
		qcom,mdss-dsi-t-clk-pre = <0x17>;         //指定模式切换前的字节时钟周期。 0x24 =默认值。
		qcom,mdss-dsi-bl-min-level = <1>;           //指定面板支持的最小背光级别。 0 =默认值。
		qcom,mdss-dsi-bl-max-level = <4095>;        //指定面板支持的最大背光级别。 255 =默认值。
		qcom,mdss-dsi-dma-trigger = "trigger_sw";   //指定用于DMA路径的触发机制。
					//"none" = no trigger
					//"trigger_te" = Tear check signal line used for trigger
					//"trigger_sw" = Triggered by software (default)
					//"trigger_sw_seof" = Software trigger and start/end of frame trigger.
					//"trigger_sw_te" = Software trigger and TE
		qcom,mdss-dsi-mdp-trigger = "none";         //指定用于MDP路径的触发机制。
					//"none" = 没有触发器
					//"trigger_te" = Tear check signal line used for trigger 用于触发的撕裂检查信号线
					//"trigger_sw" = Triggered by software (default) 由软件触发
					//"trigger_sw_te" = Software trigger and TE
		qcom,mdss-dsi-bl-pmic-control-type = "bl_ctrl_wled";   //一个字符串，指定此面板的背光控制的实现。
        //"bl_ctrl_pwm"=由PWM gpio控制的背光。
        //"bl_ctrl_wled"=由WLED控制的背光。
        //"bl_ctrl_dcs"=由DCS命令控制的背光。
        //其他:未知的背光控制。 （默认）
		qcom,mdss-dsi-reset-sequence = <1 2>, <0 2>, <1 52>; //列出重置gpio值和sleep的序列的数组每个命令的格式如下：
            //- >重置GPIO值
            //- >睡眠值（毫秒）
		qcom,esd-check-enabled;         //用于启用ESD恢复功能的布尔值。
		qcom,mdss-dsi-panel-status-command = [06 01 00 01 05 00 01 D9
			06 01 00 01 05 00 01 09
			06 01 00 01 05 00 01 45];//基于qcom dsi控制器协议的多个dcs数据包形成的字节流。
					//byte 0: dcs数据类型
					//byte 1: 设置为表示这是一个单独的数据包（没有链）
					//byte 2: 虚拟通道号
					//byte 3: 期待来自客户端的ack (dcs读取命令)
					//byte 4: 发送dcs命令后指定的ms的等待数
					//byte 5, 6: 网络字节序的16位长度
					//byte 7 and beyond: 有效负载的数字字节
		qcom,mdss-dsi-panel-status-command-state = "dsi_lp_mode";
		qcom,mdss-dsi-panel-status-check-mode = "reg_read"; //指定ESD恢复的面板状态检查方法。
          //"bta_check"=使用BTA检查面板状态
          //"reg_read"=读取面板状态寄存器以检查面板状态
          //"reg_read_nt35596"=读取面板状态寄存器以检查NT35596面板的面板状态。
          //"te_signal_check"=使用TE信号行为检查面板状态
		qcom,mdss-dsi-panel-status-read-length = <4 4 3>; //整数数组，指定每个面板寄存器的预期值回读长度。 每个长度对应于规范中引入的寄存器返回参数的数量。
		qcom,mdss-dsi-panel-status-valid-params = <1 3 2>;//整数数组，指定需要检查每个寄存器的有效返回值。 某些面板只需要检查从面板返回的前几个值。
                                                      //所以：如果这个属性与qcom，mdss-dsi-panel-status-read-length相同，那么就忽略这个。
		qcom,mdss-dsi-panel-status-value =
			<0x80 0x81 0xf3 0x04 0x05 0x0f>,
			<0x80 0x81 0xf3 0x04 0x05 0x1e>;              //多个整数数组，每个数组都指定面板状态寄存器的值，用于检查面板状态。
                                                    //每个数组的大小是qcom，mdss-dsi-panel-status-read-length中指定的长度之和，并且必须相等。
                                                    //这可以涵盖某些面板可能返回多个替代值
		qcom,mdss-dsi-panel-max-error-count = <3>;      //整数值，指定在读取面板变坏之前可以忽略的寄存器读取的最大错误数。

		qcom,mdss-dsi-lp11-init;                        //布尔值，用于在发出硬件复位线之前启用DSI时钟和数据通道（低功耗11）。
	};
};
